## package/oslec/Config.in
```kconfig
config SF_PACKAGE_ZAPTEL_OSLEC
        bool  "oslec support"
        depends on SF_PACKAGE_ZAPTEL && !SF_PACKAGE_LEC && !SF_BR4_APPLIANCE && !SF_PR1_APPLIANCE
	default "y"
        ---help---
          Say Y here if you want to have support for the OpenSource
          Line Echo Canceller (oslec).

          For more information see http://www.rowetel.com.
```

## package/pppoe/Config.in
```kconfig
#########################################################################
# This program is free software; you can redistribute it and/or modify
# it under the terms of the GNU General Public License as published by
# The Free Software Foundation; version 3 of the License.
#
# This program is distributed in the hope that it will be useful,
# but WITHOUT ANY WARRANTY; without even the implied warranty of
# MERCHANTABILITY or FITNESS FOR A PARTICULAR PURPOSE.  See the
# GNU General Public License for more details.
# Copyright @ 2011 SwitchFin <dpn@switchfin.org>
#########################################################################

config SF_PACKAGE_PPPOE
        bool "pppoe"
        default n
        help
                Enables the Point-to-Point Protocol over Ethernet (PPPoE) - a network protocol for encapsulating Point-to-Point Protocol (PPP) frames inside Ethernet frames.
```

## package/rsync/Config.in
```kconfig
#########################################################################
# This program is free software; you can redistribute it and/or modify
# it under the terms of the GNU General Public License as published by
# The Free Software Foundation; version 3 of the License.
#
# This program is distributed in the hope that it will be useful,
# but WITHOUT ANY WARRANTY; without even the implied warranty of
# MERCHANTABILITY or FITNESS FOR A PARTICULAR PURPOSE.  See the
# GNU General Public License for more details.
# Copyright @ 2008 Astfin <mark@astfin.org>
# Primary Authors: mark@astfin.org, pawel@astfin.org
# Copyright @ 2010 SwitchFin <dpn@switchfin.org>
#########################################################################

config SF_PACKAGE_RSYNC
	bool "rsync"
	default n
	help
		Limited rsync package for Switchfin. Currently only works with one
		rsync:// source or destination. SSH transfers are not possible and
		neither are entirely local transfers. Daemon functionality and the
		--fuzzy option are also disabled.
```
