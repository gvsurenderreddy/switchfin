## package/blackfin-linux-dist/Config.in
```kconfig
#########################################################################
# This program is free software; you can redistribute it and/or modify
# it under the terms of the GNU General Public License as published by
# The Free Software Foundation; version 3 of the License.
#
# This program is distributed in the hope that it will be useful,
# but WITHOUT ANY WARRANTY; without even the implied warranty of
# MERCHANTABILITY or FITNESS FOR A PARTICULAR PURPOSE.  See the
# GNU General Public License for more details.
# Copyright @ 2008 Astfin <mark@astfin.org>
# Primary Authors: mark@astfin.org, pawel@astfin.org
# Copyright @ 2010 SwitchFin <dpn@switchfin.org>
#########################################################################

config SF_PACKAGE_UCLINUX_DIST
	bool "Blackfin uClinux Dist"
	default y
	help
		Disturbition of Blackfin uClinux version

config SF_PACKAGE_UCLINUX_CONFIG
        string "uClinux configuration file to use?"
        depends SF_PACKAGE_UCLINUX_DIST
        default "package/uClinux-dist/uClinux-dist.config"
        help
          Some people may wish to use their own modified uClinux configuration
          file, and will specify their config file location with this option.

          Most people will just use the default uClinux configuration file.

choice  
        prompt "CPU Clock Speed"
        default SF_CPU_600
        depends on (SF_BR4_APPLIANCE || SF_PR1_APPLIANCE)

config SF_CPU_600
        bool "600 MHz"
        depends on (SF_BR4_APPLIANCE || SF_PR1_APPLIANCE)
        help
          Use this option if your CPU operates at 600MHz

config SF_CPU_500
        bool "500 MHz"
        depends on (SF_BR4_APPLIANCE || SF_PR1_APPLIANCE)
        help
          Use this option if your CPU operates at 500MHz

endchoice

choice  
        prompt "CPU Silicon Revisions"
        default SF_CPU_REV_3
        depends on (SF_BR4_APPLIANCE || SF_PR1_APPLIANCE)

config SF_CPU_REV_2
        bool "BF537/6 1.0.2"
        depends on (SF_BR4_APPLIANCE || SF_PR1_APPLIANCE)
        help
          Use this option if you have silicon revision 2.

config SF_CPU_REV_3
        bool "BF537/6 1.0.3"
        depends on (SF_BR4_APPLIANCE || SF_PR1_APPLIANCE)
        help
          Use this option if you have silicon revision 3.


endchoice

choice  
        prompt "Amount of SDRAM"
        default SF_SDRAM_64 if (SF_BR4_APPLIANCE)
        default SF_SDRAM_128 if (SF_PR1_APPLIANCE)
        depends on (SF_BR4_APPLIANCE || SF_PR1_APPLIANCE)

config SF_SDRAM_128
        bool "128MB SDRAM"
        depends on (SF_BR4_APPLIANCE || SF_PR1_APPLIANCE)
        help
          Use this option if you have 128MB of SDRAM.


config SF_SDRAM_64
        bool "64MB SDRAM"
        depends on (SF_BR4_APPLIANCE || SF_PR1_APPLIANCE)
        help
          Use this option if you have 64MB of SDRAM.

endchoice

choice  
        prompt "SDRAM CAS Latency"
	default SF_CAS_3
        depends on (SF_BR4_APPLIANCE || SF_PR1_APPLIANCE)

config SF_CAS_2
        bool "CAS Latency 2 (faster)"
        depends on (SF_BR4_APPLIANCE || SF_PR1_APPLIANCE)
        help
          Use this option if you have SDRAM which can operate at CAS Latency 2.


config SF_CAS_3
        bool "CAS Latency 3 (slower)"
        depends on (SF_BR4_APPLIANCE || SF_PR1_APPLIANCE)
        help
          Use this option if you have SDRAM which can operate at CAS Latency 3.
	  This is the safe choice if you are not sure what kind of SDRAM do you have.

endchoice

choice
	prompt "NAND flash"
	default SF_NAND_1GB if SF_PR1_APPLIANCE
	default SF_NAND_256MB if SF_BR4_APPLIANCE
	depends on (SF_BR4_APPLIANCE || SF_PR1_APPLIANCE)

config SF_NAND_256MB
	bool "256MB NAND Flash"
	depends on (SF_BR4_APPLIANCE || SF_PR1_APPLIANCE)
	help
	  Use this option if you have 256MB NAND flash

config SF_NAND_512MB
        bool "512MB NAND Flash"
        depends on (SF_BR4_APPLIANCE || SF_PR1_APPLIANCE)
        help
          Use this option if you have 512MB NAND flash

config SF_NAND_1GB
        bool "1GB NAND Flash"
        depends on (SF_BR4_APPLIANCE || SF_PR1_APPLIANCE)
        help
          Use this option if you have 1GB NAND flash

endchoice
```

## package/bonjour/Config.in
```kconfig
#########################################################################
# This program is free software; you can redistribute it and/or modify
# it under the terms of the GNU General Public License as published by
# The Free Software Foundation; version 3 of the License.
#
# This program is distributed in the hope that it will be useful,
# but WITHOUT ANY WARRANTY; without even the implied warranty of
# MERCHANTABILITY or FITNESS FOR A PARTICULAR PURPOSE.  See the
# GNU General Public License for more details.
# Copyright @ 2010 SwitchFin <dpn@switchfin.org>
#########################################################################

config SF_PACKAGE_BONJOUR
	bool "bonjour"
	default n
	help
		Bonjour is a networking technology that lets you create an instant network of computers and devices without any configuration. It allows the services and capabilities of each device to be registered on the network, and allows these services to be dynamically discoverable by other devices on the network.
```

## package/curl/Config.in
```kconfig
#########################################################################
# This program is free software; you can redistribute it and/or modify
# it under the terms of the GNU General Public License as published by
# The Free Software Foundation; version 3 of the License.
#
# This program is distributed in the hope that it will be useful,
# but WITHOUT ANY WARRANTY; without even the implied warranty of
# MERCHANTABILITY or FITNESS FOR A PARTICULAR PURPOSE.  See the
# GNU General Public License for more details.
# Copyright @ 2010 SwitchFin <dpn@switchfin.org>
#########################################################################

config SF_PACKAGE_CURL
        bool "curl"
        default n
        help
                curl is a tool to transfer data from or to a server, using one of the supported protocols (HTTP, HTTPS, FTP, FTPS, SCP, SFTP, TFTP, DICT, TELNET, LDAP or FILE).
```

## package/dahdi/Config.in
```kconfig
#########################################################################
# This program is free software; you can redistribute it and/or modify
# it under the terms of the GNU General Public License as published by
# The Free Software Foundation; version 3 of the License.
#
# This program is distributed in the hope that it will be useful,
# but WITHOUT ANY WARRANTY; without even the implied warranty of
# MERCHANTABILITY or FITNESS FOR A PARTICULAR PURPOSE.  See the
# GNU General Public License for more details.
# Copyright @ 2010 SwitchFin <dpn@switchfin.org>
#########################################################################

config SF_PACKAGE_DAHDI_EXTRATOOLS
	bool "DAHDI Extra Tools"
	default n
	depends on !SF_BR4_APPLIANCE
	help
		Enable some useful DAHDI tools like dahdi_speed dahdi_test dahdi_monitor 
		dahdi_maint fxotune  

config SF_PACKAGE_DAHDI_GSM1
        bool "GSM1 support"
	default n
        depends on SF_IP01 || SF_IP04
        help
		GSM module (GSM1) support for IP01/IP02/IP04/IP08 PBXs This is done by a separate option now. After some testing the
 		support will be added in the main line IP0x and this menu option will be removed
```

## package/flite/Config.in
```kconfig
config SF_PACKAGE_FLITE
	bool "Flite"
	default n
	help
		Smaller, faster and more portable alternative to the Festival
		speech synthesis engine.

config SF_FLITE_VOX_cmu_time_awb
		bool "CMU Time AWB"
		depends on SF_PACKAGE_FLITE

config SF_FLITE_VOX_cmu_us_awb
		bool "CMU US AWB"
		depends on SF_PACKAGE_FLITE

config SF_FLITE_VOX_cmu_us_kal
		bool "CMU US KAL"
		depends on SF_PACKAGE_FLITE
		default y

config SF_FLITE_VOX_cmu_us_kal16
		bool "CMU US KAL (16KHz)"
		depends on SF_PACKAGE_FLITE

config SF_FLITE_VOX_cmu_us_rms
		bool "CMU US RMS"
		depends on SF_PACKAGE_FLITE

config SF_FLITE_VOX_cmu_us_slt
		bool "CMU US SLT"
		depends on SF_PACKAGE_FLITE
```

## package/home-auto/Config.in
```kconfig
#########################################################################
# This program is free software; you can redistribute it and/or modify
# it under the terms of the GNU General Public License as published by
# The Free Software Foundation; version 3 of the License.
#
# This program is distributed in the hope that it will be useful,
# but WITHOUT ANY WARRANTY; without even the implied warranty of
# MERCHANTABILITY or FITNESS FOR A PARTICULAR PURPOSE.  See the
# GNU General Public License for more details.
# Copyright @ 2011 SwitchFin <dpn@switchfin.org>
#########################################################################

config SF_PACKAGE_HOME_AUTO
        bool "home-auto"
        default n
	depends on SF_IP04
        help
                This option will enable variours home automation extensions in the IP0x Switchfin kernel. To use it you need to have WireLess Tele Controller (WLTC) hardware module.
```

## package/iksemel/Config.in
```kconfig
config SF_PACKAGE_IKSEMEL
	bool "iksemel"
	default y
	help
		iksemel is an XML (eXtensible Markup Language) parser library designed for Jabber applications. (for Google Voice support)
```

## package/inadyn/Config.in
```kconfig
config SF_PACKAGE_INADYN
	bool "inadyn"
	default y
	help
		inadyn is a client for 'open' name servers. That is, it let the user have an Internet recognized name for his machine by transferring to him some control over a name server that he does not manage. Some of the services that are offered by those open name servers are free of charge, and work even when the client machine does not have a static IP. The name servers that are supported by inayn are: http://www.dyndns.org and http://freedns.afraid.org 
```

## package/iptables/Config.in
```kconfig
#########################################################################
# This program is free software; you can redistribute it and/or modify
# it under the terms of the GNU General Public License as published by
# The Free Software Foundation; version 3 of the License.
#
# This program is distributed in the hope that it will be useful,
# but WITHOUT ANY WARRANTY; without even the implied warranty of
# MERCHANTABILITY or FITNESS FOR A PARTICULAR PURPOSE.  See the
# GNU General Public License for more details.
# Copyright @ 2010 SwitchFin <dpn@switchfin.org>
#########################################################################

config SF_PACKAGE_IPTABLES
        bool "iptables"
        default n
        help
                iptables is a user space application program that allows to configure the tables provided by the Linux kernel firewall (implemented as different Netfilter modules) and the chains and rules it stores.
```

## package/lec/Config.in
```kconfig
#
# Zarlink Hardware Based Echo Cancellation Module
#

#menu "LEC Support"
config SF_PACKAGE_LEC	 
         bool "Support for Zarlink Hardware Based Echo Canceller"	 
         depends on SF_PACKAGE_UCLINUX_DIST && (SF_BR4_APPLIANCE || SF_PR1_APPLIANCE)	 
         default "y"	 
         ---help---	 
           Say Y here if you have a hardware based echo cancellation	 
           installed in your appliance.

config SF_LEC_128
            bool "Support for 128ms tail length (Zarlink chip)"
            depends on  SF_PACKAGE_LEC && SF_BR4_APPLIANCE
            help
              Use this option if you have at least 16 channels chip.


#endmenu
```

## package/lighttpd/Config.in
```kconfig
#########################################################################
# This program is free software; you can redistribute it and/or modify
# it under the terms of the GNU General Public License as published by
# The Free Software Foundation; version 3 of the License.
#
# This program is distributed in the hope that it will be useful,
# but WITHOUT ANY WARRANTY; without even the implied warranty of
# MERCHANTABILITY or FITNESS FOR A PARTICULAR PURPOSE.  See the
# GNU General Public License for more details.
# Copyright @ 2008 Astfin <mark@astfin.org>
# Primary Authors: mark@astfin.org, pawel@astfin.org
# Copyright @ 2010 SwitchFin <dpn@switchfin.org>
#########################################################################

config SF_PACKAGE_LIGHTTPD
	bool "lighttpd"
	default n
	help
		Light Web Server
```

## package/lua/Config.in
```kconfig
#########################################################################
# This program is free software; you can redistribute it and/or modify
# it under the terms of the GNU General Public License as published by
# The Free Software Foundation; version 3 of the License.
#
# This program is distributed in the hope that it will be useful,
# but WITHOUT ANY WARRANTY; without even the implied warranty of
# MERCHANTABILITY or FITNESS FOR A PARTICULAR PURPOSE.  See the
# GNU General Public License for more details.
# Copyright @ 2010 SwitchFin <dpn@switchfin.org>
#########################################################################

config SF_PACKAGE_LUA
        bool "lua"
        default n
        help
                Lua is a powerful, fast, lightweight, embeddable scripting language. Using pbx_lua you can create your asterisk dialplan in lua
```

## package/mISDN/Config.in
```kconfig
#########################################################################
# This program is free software; you can redistribute it and/or modify
# it under the terms of the GNU General Public License as published by
# The Free Software Foundation; version 3 of the License.
#
# This program is distributed in the hope that it will be useful,
# but WITHOUT ANY WARRANTY; without even the implied warranty of
# MERCHANTABILITY or FITNESS FOR A PARTICULAR PURPOSE.  See the
# GNU General Public License for more details.
# Copyright @ 2008 Astfin <mark@astfin.org>
# Primary Authors: mark@astfin.org, pawel@astfin.org
# Copyright @ 2010 SwitchFin <dpn@switchvoice.com>
#########################################################################

config SF_PACKAGE_MISDN
	bool "mISDN"
	default y
	depends SF_BR4_APPLIANCE || SF_E121
	help
		Open source ISDN stack
```

## package/n2n/Config.in
```kconfig
config SF_PACKAGE_N2N
	bool "n2n"
	default n
	help
		n2n is an open source VPN application that utilizes a peer-to-peer architecture for network membership and routing. It is small but very powerful.
choice
	prompt "n2n version"
	default SF_N2N_V1
	depends on SF_PACKAGE_N2N

config SF_N2N_V1
		bool "n2n v1"
		depends on SF_PACKAGE_N2N

config SF_N2N_V2
		bool "n2n v2 (EXPERIMENTAL)"
		depends on SF_PACKAGE_N2N

endchoice
```

## package/nfs/Config.in
```kconfig
#########################################################################
# This program is free software; you can redistribute it and/or modify
# it under the terms of the GNU General Public License as published by
# The Free Software Foundation; version 3 of the License.
#
# This program is distributed in the hope that it will be useful,
# but WITHOUT ANY WARRANTY; without even the implied warranty of
# MERCHANTABILITY or FITNESS FOR A PARTICULAR PURPOSE.  See the
# GNU General Public License for more details.
# Copyright @ 2010 SwitchFin <dpn@switchfin.org>
#########################################################################

config SF_PACKAGE_NFS
        bool "nfs"
        default n
        help
                Enables Network File System (NFS) Client support in the kernel. NFS allows PBX to read/write data from a remote server. For our VOIP applications it is useful for recording of the conversations directly to the external network storage. It can be used for external storage for big library of sound prompts.
```
