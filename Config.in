## Config.in
```kconfig
#########################################################################
# This program is free software; you can redistribute it and/or modify
# it under the terms of the GNU General Public License as published by
# The Free Software Foundation; version 3 of the License.
#
# This program is distributed in the hope that it will be useful,
# but WITHOUT ANY WARRANTY; without even the implied warranty of
# MERCHANTABILITY or FITNESS FOR A PARTICULAR PURPOSE.  See the
# GNU General Public License for more details.
# Copyright @ 2008 Astfin <mark@astfin.org>
# Primary Authors: mark@astfin.org, pawel@astfin.org
# Update 27 July 2009, Dimitar Penev dpn@ucpbx.com
#        uClinux 2009R1-RC2 (kernel 2.6.28.10)
#        blackfin toolchain 2009R1-RC
# Copyright @ 2010 SwitchFin <dpn@switchfin.org>
#########################################################################

mainmenu "SwitchFin Configuration"

config SF_HAVE_DOT_CONFIG
        bool
        default y

config SF_TARGET_TOOLCHAIN_COMPILER_4
        bool
	default y

choice
        prompt "Target Architecture"
        default SF_PR1_APPLIANCE
        help
          Stuff

config SF_PR1_APPLIANCE
	bool "PR1 Appliance"
config SF_BR4_APPLIANCE
        bool "BR4 Appliance"
config SF_IP04
	bool "IP02/IP04 Analog PBX"
config SF_IP08
        bool "IP08 Analog PBX"
config SF_IP01
	bool "IP01/IP01p Analog PBX"
config SF_FX08
	bool "FX08 Analog PBX"

endchoice

choice
	prompt "Target Architecture Configuration"
	default SF_TARGET_DEFAULTS
config SF_TARGET_DEFAULTS
	bool "Default Settings"
config SF_TARGET_CUSTOM
	bool "Custom Kernel Options"
endchoice

source "package/Config.in"

menu "Build options"

config SF_WGET
	string "Wget command"
	default "wget --passive-ftp -nd"

config SF_SVN
	string "Subversion (svn) checkout command"
	default "svn co"

config SF_TAR_OPTIONS
	string "Tar options"
	default ""
	help
	  Options to pass to tar when extracting the sources.
	  E.g. " -v --exclude='*.svn*'" to exclude all .svn internal files
	  and to be verbose.

config SF_DL_DIR
	string "Download dir"
	default "$(BASE_DIR)/dl"
	help
	  Directory to store all the source files that we need to fetch.

config SF_SOURCEFORGE_MIRROR
	string "Sourceforge mirror site"
	default "easynews"
	help
	    Sourceforge has a system of mirror sites.  Some sites may be closer
	    to your location, and sometimes mirror sites go down and are no longer
	    available.  This option allows you to select your preferred Sourceforge
	    mirror site.

	    The list of mirrors is available here:
	    http://prdownloads.sourceforge.net/index-sf.html?download

config SF_TOPDIR_PREFIX
	string "Custom build dir prefix"
	default ""
	help
	    Add a custom string to the beginning of the build directories.

	    build_ARCH -> [PREFIX]_build_ARCH
	    toolchain_build_ARCH -> [PREFIX]_toolchain_build_ARCH

config SF_TOPDIR_SUFFIX
	string "Custom build dir suffix"
	default ""
	help
	    Add a custom string to the end of the build directories.

	    build_ARCH -> build_ARCH_[SUFFIX]
	    toolchain_build_ARCH -> toolchain_build_ARCH_[SUFFIX]

config SF_GNU_BUILD_SUFFIX
	string "GNU build hostname suffix"
	default "bfin-uclinux"
	help
	    The string used to pass to configure scripts via the
	    --build= option.  Just specify the suffix here, the leading
	    arch will be filled in automatically.

config SF_JLEVEL
	int "Number of jobs to run simultaneously"
	default "1"
	help
	    Number of jobs to run simultanesouly

endmenu
```

## package/Config.in
```kconfig
#########################################################################
# This program is free software; you can redistribute it and/or modify
# it under the terms of the GNU General Public License as published by
# The Free Software Foundation; version 3 of the License.
#
# This program is distributed in the hope that it will be useful,
# but WITHOUT ANY WARRANTY; without even the implied warranty of
# MERCHANTABILITY or FITNESS FOR A PARTICULAR PURPOSE.  See the
# GNU General Public License for more details.
# Copyright @ 2008 Astfin <mark@astfin.org>
# Primary Authors: mark@astfin.org, pawel@astfin.org
# Copyright @ 2010 SwitchFin <dpn@switchfin.org>
#########################################################################

menu "Package Selection for the target"

comment "The default minimal system"
source "package/uClinux-dist/Config.in"
source "package/uBoot/Config.in"


comment "Hardware settings"
#source "package/gsm1/Config.in"
source "package/lec/Config.in"
source "package/home-auto/Config.in"
comment "DAHDI"
source "package/dahdi/Config.in"
comment "Asterisk"
source "package/asterisk/Config.in"
source "package/attrafax/Config.in"
comment "GUI"
source "package/asterisk-gui/Config.in"
comment "Flite"
source "package/flite/Config.in"
comment "Applications"
source "package/tftpd/Config.in"
source "package/perl/Config.in"
source "package/mISDN/Config.in"
source "package/mISDNuser/Config.in"
source "package/lighttpd/Config.in"
source "package/ssmtp/Config.in"
source "package/n2n/Config.in"
source "package/rsync/Config.in"
source "package/cgic/Config.in"
source "package/vim/Config.in"
source "package/bonjour/Config.in"
source "package/inadyn/Config.in"
source "package/curl/Config.in"
source "package/procwatch/Config.in"
source "package/libtiff/Config.in"
source "package/ghostscript/Config.in"
source "package/lua/Config.in"
source "package/uw-imap/Config.in"
source "package/iptables/Config.in"
source "package/nfs/Config.in"
endmenu
```

## package/OpenR2/Config.in
```kconfig
#########################################################################
# This program is free software; you can redistribute it and/or modify
# it under the terms of the GNU General Public License as published by
# The Free Software Foundation; version 3 of the License.
#
# This program is distributed in the hope that it will be useful,
# but WITHOUT ANY WARRANTY; without even the implied warranty of
# MERCHANTABILITY or FITNESS FOR A PARTICULAR PURPOSE.  See the
# GNU General Public License for more details.
# Copyright @ 2011 SwitchFin <dpn@switchfin.org>
#########################################################################

config SF_PACKAGE_OPENR2
        bool "openr2"
        default n
	depends on (SF_PR1_APPLIANCE)
        help
               	OpenR2 is a library that implements the MFC/R2 telephony signaling protocol over E1 lines. 
```

## package/asterisk-gui/Config.in
```kconfig
#########################################################################
# This program is free software; you can redistribute it and/or modify
# it under the terms of the GNU General Public License as published by
# The Free Software Foundation; version 3 of the License.
#
# This program is distributed in the hope that it will be useful,
# but WITHOUT ANY WARRANTY; without even the implied warranty of
# MERCHANTABILITY or FITNESS FOR A PARTICULAR PURPOSE.  See the
# GNU General Public License for more details.
# Copyright @ 2008 Astfin <mark@astfin.org>
# Primary Authors: mark@astfin.org, pawel@astfin.org, li@astfin.org
# Copyright @ 2010 SwitchFin <dpn@switchfin.org>
#########################################################################
config SF_PACKAGE_ASTERISKGUI
        bool "Asterisk - Switchfin GUI"
        default y
	depends SF_PACKAGE_ASTERISK
        help
                Disturbition of AsteriskNow for Astfin, if you select this option 
		please deselect php and lighttpd

choice
        prompt "Asterisk GUI"
        default SF_ASTERISK_GUI_3_0 if (SF_IP04 || SF_PR1_APPLIANCE || SF_BR4_APPLIANCE || SF_FX08)
        depends on SF_PACKAGE_ASTERISK

config SF_PACKAGE_NOGUI
        bool "Asterisk without GUI"
        depends on (SF_PACKAGE_ASTERISK)
        help
          Asterisk without web based GUI.

config SF_ASTERISK_GUI_3_0
        bool "Asterisk GUI 3.0"
        depends on SF_PACKAGE_ASTERISK
        help
          Asterisk GUI 3.0 currently recommend for production boxes

config SF_ASTERISK_GUI_4_0
        bool "Asterisk GUI 4.0"
        depends on SF_PACKAGE_ASTERISK
        help
          New Asterisk GUI. Still not recommend for production boxes.

endchoice
```

## package/asterisk/Config.in
```kconfig
#########################################################################
# This program is free software; you can redistribute it and/or modify
# it under the terms of the GNU General Public License as published by
# The Free Software Foundation; version 3 of the License.
#
# This program is distributed in the hope that it will be useful,
# but WITHOUT ANY WARRANTY; without even the implied warranty of
# MERCHANTABILITY or FITNESS FOR A PARTICULAR PURPOSE.  See the
# GNU General Public License for more details.
# Copyright @ 2008 Astfin <mark@astfin.org>
# Primary Authors: mark@astfin.org, pawel@astfin.org
# Copyright @ 2010 SwitchFin <dpn@switchfin.org>
#########################################################################

config SF_PACKAGE_ASTERISK
	bool "Asterisk"
	default y
	help
		Open source PBX
choice
        prompt "Asterisk version"
        default SF_ASTERISK_1_4
        depends on SF_PACKAGE_ASTERISK

config SF_ASTERISK_1_4
        bool "Asterisk 1.4"
        depends on SF_PACKAGE_ASTERISK
        help
          Asterisk 1.4 recommend for production boxes 

config SF_ASTERISK_1_6
        bool "Asterisk 1.6 (Experimental)"
        depends on SF_PACKAGE_ASTERISK
        help
          Asterisk 1.6 bringing up new features. Experimental, still not recommend for production boxes.

config SF_ASTERISK_1_8
        bool "Asterisk 1.8 (Experimental)"
        depends on SF_PACKAGE_ASTERISK
        help
          Asterisk 1.8 bringing up new features. Experimental, still not recommend for production boxes.

endchoice

config SF_PACKAGE_ASTERISK_VERBOSE
	bool "Asterisk custom setting"
	default n
	depends SF_PACKAGE_ASTERISK
	help
		Custom setting for Asterisk menuconfig

config SF_SPANDSP_FAX
		bool "SpanDSP-based Fax"
		default n
		depends SF_PACKAGE_ASTERISK
		help
			SpanDSP-based app_fax Asterisk application for sending/receiving
			TIFF faxes.

config SF_SPANDSP_CALLERID
		bool "SpanDSP-based Caller ID (EXPERIMENTAL)"
		default y
		depends SF_PACKAGE_ASTERISK
		help    
			SpanDSP-based Caller ID decoding.

config SF_PACKAGE_ASTERISK-H323
        bool "h.323 support for Asterisk"
        default n
        depends SF_PACKAGE_ASTERISK
        help
                h.323 support for Asterisk, experimental

config SF_PACKAGE_ASTERISK_G729
        bool "g.729 codec EVALUATION ONLY, READ HELP!!!!"
        default n
        depends SF_PACKAGE_ASTERISK
        help    
                g.729 codec for testing/evaluation purposes only.
                You need to pay royalties to patent holders if
                you want to use it for commercial purposes.
                Please contact SIPRO (www.sipro.com) to obtain applicable
                licenses.

                Switchfin is not responsible nor shall it be held liable
                for licensing and/or patent infringement,
                including but not limited to indirect infingment,
                contributory infringement and induced infringement.

		Please note that in addition you will need to compile g729 library (libgfdots).

config SF_PACKAGE_NVFAX
        bool "Fax Detection for IAX/SIP/ZAP"
        default y
        depends SF_ASTERISK_1_4
        help
		This applications listens for fax tones (on IAX and SIP channels too) 
		for waitdur seconds of time. In addition, it can be interrupted by digits, 
		or non-silence. Audio is only monitored in the receive direction. 
		If digits interrupt, they must be the start of a valid extension unless 
		the option is included to ignore. If fax is detected, it will jump to the 
		'fax' extension. If a period of non-silence greater than 'mindur' ms, 
		yet less than 'maxdur' ms is followed by silence at least 'sildur' ms 
		then the app is aborted and jumps to the 'talk' extension. 
		If all undetected, control will continue at the next priority.

config SF_PACKAGE_DEVSTATE
        bool "Devstate for Asterisk 1.4"
        default n
        depends SF_ASTERISK_1_4
        help
		The DEVICE_STATE function can be used to retrieve the device state from any device state provider.
		is the current way to get a devices state.  
```

## package/attrafax/Config.in
```kconfig
#########################################################################
# This program is free software; you can redistribute it and/or modify
# it under the terms of the GNU General Public License as published by
# The Free Software Foundation; version 3 of the License.
#
# This program is distributed in the hope that it will be useful,
# but WITHOUT ANY WARRANTY; without even the implied warranty of
# MERCHANTABILITY or FITNESS FOR A PARTICULAR PURPOSE.  See the
# GNU General Public License for more details.
# Copyright @ 2010 SwitchFin <dpn@switchfin.org>
#########################################################################

config SF_PACKAGE_ATTRAFAX
	bool "attrafax"
	default y
	depends on (SF_ASTERISK_1_4)
	help
		Attrafax solution consists of a T.30/T.38 stack, with an Asterisk interface including gatewaying support.
```

## package/avahi/Config.in
```kconfig
#########################################################################
# This program is free software; you can redistribute it and/or modify
# it under the terms of the GNU General Public License as published by
# The Free Software Foundation; version 3 of the License.
#
# This program is distributed in the hope that it will be useful,
# but WITHOUT ANY WARRANTY; without even the implied warranty of
# MERCHANTABILITY or FITNESS FOR A PARTICULAR PURPOSE.  See the
# GNU General Public License for more details.
# Copyright @ 2010 SwitchFin <dpn@switchfin.org>
#########################################################################

config SF_PACKAGE_AVAHI
	bool "avahi"
	default n
	help
		Avahi for Switchfin. Avahi is a system which facilitates service discovery on a local network.This means that you can plug your laptop or computer into a network and instantly be able to view other people who you can chat with, find printers to print to or find files being shared. This kind of technology is already found in Apple MacOS X (branded Rendezvous, Bonjour and sometimes Zeroconf) and is very convenient. Avahi is mainly based on Lennart Poettering's flexmdns mDNS implementation for Linux which has been discontinued in favour of Avahi. 
```
