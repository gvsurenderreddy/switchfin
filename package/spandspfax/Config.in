## package/spandspfax/Config.in
```kconfig
#########################################################################
# This program is free software; you can redistribute it and/or modify
# it under the terms of the GNU General Public License as published by
# The Free Software Foundation; version 3 of the License.
#
# This program is distributed in the hope that it will be useful,
# but WITHOUT ANY WARRANTY; without even the implied warranty of
# MERCHANTABILITY or FITNESS FOR A PARTICULAR PURPOSE.  See the
# GNU General Public License for more details.
# Copyright @ 2010 SwitchFin <dpn@switchfin.org>
#########################################################################

config SF_PACKAGE_SPANDSPFAX
	bool "spandspfax"
	default n
	depends on (SF_ASTERISK_1_4)
	help
		If enabled you will get app_fax Asterisk application included in your image. It is for sending/receiving a TIFF FAX file. It is based on Spandsp library. 
```

## package/ssmtp/Config.in
```kconfig
#########################################################################
# This program is free software; you can redistribute it and/or modify
# it under the terms of the GNU General Public License as published by
# The Free Software Foundation; version 3 of the License.
#
# This program is distributed in the hope that it will be useful,
# but WITHOUT ANY WARRANTY; without even the implied warranty of
# MERCHANTABILITY or FITNESS FOR A PARTICULAR PURPOSE.  See the
# GNU General Public License for more details.
# Copyright @ 2008 Astfin <mark@astfin.org>
# Primary Author: mark@astfin.org
# Copyright @ 2010 SwitchFin <dpn@switchvoice.com>
#########################################################################

config SF_PACKAGE_SSMTP
	bool "ssmtp"
	default y if (SF_PACKAGE_ASTERISKGUI)
	default n
	help
		Small SMTP mailer package for Astfin
```

## package/uClinux-dist/vendors/Rowetel/IP01/pre_config/Kconfig.patch
```kconfig
--- blackfin-linux-dist/linux-2.6.x/arch/blackfin/Kconfig	2009-08-12 00:28:53.000000000 +0300
+++ blackfin-linux-dist/linux-2.6.x/arch/blackfin/Kconfig	2009-09-07 17:18:03.000000000 +0300
@@ -387,6 +387,27 @@
 	  to the kernel, you may specify one here. As a minimum, you should specify
 	  the memory size and the root device (e.g., mem=8M, root=/dev/nfs).
 
+comment "Hardware addresses"
+
+config IP0X_NET1
+       hex "DM9000 eth0 hardware address"
+       default 0x20100000
+       help
+         Base address of DM9000A Ethernet chip used for eth0
+
+config IP0X_NET2
+       hex "DM9000 eth1 hardware address"
+       default 0x20200000
+       help
+         Base address of DM9000A Ethernet chip used for eth1
+
+config IP0X_USB
+       hex "ISP1362 address"
+       default 0x20300000
+       help
+         Base address of ISP1362 USB controller
+
+
 config BOOT_LOAD
 	hex "Kernel load address for booting"
 	default "0x1000"
@@ -456,6 +477,7 @@
 	default "20" if BFIN561_EZKIT
 	default "16" if (H8606_HVSISTEMAS || BLACKSTAMP || BFIN526_EZBRD || BFIN518F_EZBRD)
	default "25" if BFIN527_AD7160EVAL
+	default "40" if BFIN532_IP0X
 	help
 	  This controls the frequency of the on-chip PLL. This can be between 1 and 64.
 	  PLL Frequency = (Crystal Frequency) * (this setting)
--- blackfin-linux-dist/linux-2.6.x/drivers/mtd/nand/Kconfig	2011-05-19 16:47:17.000000000 +0300
+++ blackfin-linux-dist/linux-2.6.x/drivers/mtd/nand/Kconfig	2011-05-19 17:04:00.000000000 +0300
@@ -488,4 +488,47 @@
 	  This enables the driver for the NAND Flash on evaluation board based
 	  on w90p910.
 
+config BFIN_NAND_PLAT_BASE
+	hex "NAND Flash Base Address"
+	depends on MTD_NAND_PLATFORM
+	default 0x20000000
+	help
+	  NAND Flash Base Address
+ 
+config BFIN_NAND_PLAT_SIZE
+	hex "NAND Flash Size"
+	depends on MTD_NAND_PLATFORM
+	default 0x10000000
+	help
+	  NAND Flash size, for example 0x10000000 for 256Mbyte, or
+	  0x02000000 for 32MByte.  The NAND will be divided into
+	  two partitions.  The first partition is 8M (kernel), the
+	  second partition the remaining space (e.g. yaffs).
+ 
+config BFIN_NAND_PLAT_CLE
+	int "NAND Flash Command Latch Enable (CLE) Address strobe A[x]"
+	depends on MTD_NAND_PLATFORM
+	range 1 19
+	default 2
+	help
+	  NAND Flash Command Latch Enable (CLE) Address strobe A[x]
+ 
+config BFIN_NAND_PLAT_ALE
+	int "NAND Flash Address Latch Enable (ALE) Address strobe A[x]"
+	depends on MTD_NAND_PLATFORM
+	range 1 19
+	default 1
+	help
+	  NAND Flash Address Latch Enable (ALE) Address strobe A[x]
+ 
+config BFIN_NAND_PLAT_READY
+	int "NAND Flash Ready Strobe PF[x]"
+	depends on MTD_NAND_PLATFORM
+	range 0 15 if (BF533 || BF532 || BF531)
+	range 0 47 if (BF534 || BF536 || BF537)
+	range 0 47 if BF561
+	default 10
+	help
+	  NAND Flash Ready Strobe PF[x]
+
 endif # MTD_NAND
--- blackfin-linux-dist/linux-2.6.x/arch/blackfin/mach-bf533/boards/Kconfig	2011-05-20 20:33:49.000000000 +0300
+++ blackfin-linux-dist/linux-2.6.x/arch/blackfin/mach-bf533/boards/Kconfig	2011-05-20 20:34:13.000000000 +0300
@@ -34,7 +34,7 @@
 
 config BFIN532_IP0X
 	bool "IP04/IP08 IP-PBX"
-	depends on (BF532)
+	depends on (BF532 || BF533)
 	help
 	  Core support for IP04/IP04 open hardware IP-PBX.
 
```

## package/vtun/Config.in
```kconfig
#########################################################################
# This program is free software; you can redistribute it and/or modify
# it under the terms of the GNU General Public License as published by
# The Free Software Foundation; version 3 of the License.
#
# This program is distributed in the hope that it will be useful,
# but WITHOUT ANY WARRANTY; without even the implied warranty of
# MERCHANTABILITY or FITNESS FOR A PARTICULAR PURPOSE.  See the
# GNU General Public License for more details.
# Copyright @ 2008 Astfin <xjimenz@capatres.com>
#########################################################################

config SF_PACKAGE_VTUN
	bool "Vtun"
	default n
	help
		Lite VPN software
```

## package/yate/Config.in
```kconfig
config SF_PACKAGE_YATE
	bool "Yate"
	default n
	help
		Yet Another Telephony Engine.
```

## package/zaptel/Config.in
```kconfig
#
# Zapata Telephony device configuration
#

#menu "Zaptel Support"
config SF_PACKAGE_ZAPTEL
	bool "Zapata telephony support"
	depends on SF_PACKAGE_UCLINUX_DIST && !SF_BR4_APPLIANCE
	default "y"
        ---help---
          Say Y here if you have a Digium card, which for example allows
          you to use a regular phone for voice-over-IP applications.


config SF_PACKAGE_ZAPTEL_TOOLS
bool "Zaptel extra tools"
        depends on SF_PACKAGE_ZAPTEL 
        default "n"
        ---help---
	Say Y if you want to compile patgen, pattest and patlooptest
	tools. 

	Helpfull for debuggin PRI lines.
	


choice
        prompt "Interrupt processing - EXPERIMENTAL"
        default SF_CHUNKSIZE_1
        depends on (SF_PR1_APPLIANCE)

config SF_CHUNKSIZE_1
        bool "1ms"
        depends on (SF_PR1_APPLIANCE)
        help
          This is the default option (1ms)


config SF_CHUNKSIZE_2
        bool "2ms"
        depends on (SF_PR1_APPLIANCE)
        help
          Do not use it unless you understand it!!!!

config SF_CHUNKSIZE_5
        bool "5ms"
        depends on (SF_PR1_APPLIANCE)
        help
          Do not use it unless you fully understand it!!!!
endchoice


config SF_PACKAGE_ZAPTEL_IP04
        bool "IP0X support"
        depends on SF_PACKAGE_ZAPTEL && SF_IP04
        default "y"
        ---help---
          Say Y here if you want to have support for the Open Hardware
          analog PBX.

          For more information see http://svn.astfin.org.


config SF_PACKAGE_ZAPTEL_FX08
        bool "FX08 support"
        depends on SF_PACKAGE_ZAPTEL && SF_FX08
        default "y"
        ---help---
          Say Y here if you want to have support for the Open Hardware
          analog PBX.

          For more information see http://svn.astfin.org.


choice
        prompt "SPI BUS"
        depends on (SF_PACKAGE_ZAPTEL_IP04 || SF_PACKAGE_ZAPTEL_FX08)
        default SF_PACKAGE_ZAPTEL_IP04_SPI_SPORT

config SF_PACKAGE_ZAPTEL_IP04_SPI_SPI
        bool "TDM and MMC share SPI bus"
        depends on (SF_PACKAGE_ZAPTEL_IP04)
        help
          Use this option if you wan to use a single SPI bus for your TDM interfaces
	  and SD/MMC card.

config SF_PACKAGE_ZAPTEL_IP04_SPI_SPORT
        bool "SPORT emulates secondary SPI bus"
        depends on (SF_PACKAGE_ZAPTEL_IP04 || SF_PACKAGE_ZAPTEL_FX08)
        help
          Use this option to emulate secondary SPI bus using Sport bus.

endchoice

config SF_PACKAGE_ZAPTEL_PR1
        bool "PR1 support"
        depends on SF_PACKAGE_ZAPTEL && SF_PR1_APPLIANCE
	default "y"
        ---help---
          Say Y here if you want to have support for the OpenHardware
          single span T1/E1 board for Blackfin based boards.
          Please note that this module was specifically desing for BF1.

          For more information see http://svn.astfin.org.

          To compile this driver as a module, choose M here: the
          module will be called wpr1.ko.

choice
        prompt "Oscillator Frequency"
        depends on (SF_PACKAGE_ZAPTEL_PR1)
        default SF_PACKAGE_ZAPTEL_PR1_CLOCK_10

config SF_PACKAGE_ZAPTEL_PR1_CLOCK_2
        bool "2.048 MHz"
        depends on (SF_PACKAGE_ZAPTEL_PR1)
        help
          2.048 MHz Clock.

config SF_PACKAGE_ZAPTEL_PR1_CLOCK_8
        bool "8.192 MHz"
        depends on (SF_PACKAGE_ZAPTEL_PR1)
        help
          8.192 MHz Clock.
config SF_PACKAGE_ZAPTEL_PR1_CLOCK_10
        bool "10.000 MHz"
        depends on (SF_PACKAGE_ZAPTEL_PR1)
        help
          10.000 MHz Clock.

endchoice

config SF_PACKAGE_ZAPTEL_4FX
        bool "FXO/FXS interfaces support"
	default "y"
        depends  on SF_PACKAGE_ZAPTEL && !SF_PR1_APPLIANCE
        ---help---
          Say Y here if you want to have support for FXS/FXO 
          interface in IP04

          For more information see http://www.rowetel.com.

          To compile this driver as a module, choose M here: the
          module will be called wcfxs.ko.

config SF_PACKAGE_ZAPTEL_GSM
        bool "GSM support EXPERIMENTAL!"
        depends on SF_PACKAGE_ZAPTEL && (SF_FX08 || SF_IP04) && SF_PACKAGE_ZAPTEL_4FX
        default "n"
        ---help---
          Say Y here if you want to have support for the GSM1 module

          For more information see http://blog.astfin.org.

config SF_PACKAGE_ZAPTEL_ZTDUMMY
        bool "ztdummy support"
        depends on SF_PACKAGE_ZAPTEL
        ---help---
          Say Y here if you do not have any modules for the Digium S800I
          Asterisk appliance.  This driver provides a zaptel timing
          source.

          For more information see http://www.digium.com.

          To compile this driver as a module, choose M here: the
          module will be called ztdummy.ko.

config SF_PACKAGE_ZAPTEL_TDMOE
        bool "TDMoE support"
        depends on SF_PACKAGE_ZAPTEL
        ---help---
          Say Y here if you want to have support for the TDMoE

          For more information see http://www.digium.com.

          To compile this driver as a module, choose M here: the
          module will be called ztd_eth.ko.


#endmenu
```
